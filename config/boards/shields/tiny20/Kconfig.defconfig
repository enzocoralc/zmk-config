## config/boards/shields/tiny20/Kconfig.defconfig
```kconfig
# Copyright (c) 2022 The ZMK Contributors
# SPDX-License-Identifier: MIT

if SHIELD_TINY_LEFT

config ZMK_KEYBOARD_NAME
	default "Tiny20"

config ZMK_SPLIT_ROLE_CENTRAL
	default y

endif

if SHIELD_TINY_LEFT || SHIELD_TINY_RIGHT

config ZMK_SPLIT
	default y

endif
```

## config/boards/shields/tiny20/Kconfig.shield
```kconfig
# Copyright (c) 2022 The ZMK Contributors
# SPDX-License-Identifier: MIT

config SHIELD_TINY_LEFT
	def_bool $(shields_list_contains,tiny20_left)

config SHIELD_TINY_RIGHT
	def_bool $(shields_list_contains,tiny20_right)
```

## config/boards/shields/tiny20/kconfig.shield
```kconfig
# Copyright (c) 2022 The ZMK Contributors
# SPDX-License-Identifier: MIT

config SHIELD_TINY_LEFT
	def_bool $(shields_list_contains,tiny_left)

config SHIELD_TINY_RIGHT
	def_bool $(shields_list_contains,tiny_right)
```

## config/west.yml
```yaml
manifest:
  remotes:
    - name: zmkfirmware
      url-base: https://github.com/zmkfirmware
    - name: enzocoralc
      url-base: https://github.com/enzocoralc
  projects:
    # - name: zmk
    #   remote: zmkfirmware
    #   revision: main
    #   import: app/west.yml
    - name: zmk
      remote: enzocoralc
      revision: seeeduino-xiao-ble-compatible
      import: app/west.yml
  self:
    path: config
```
